## lib/wasm-micro-runtime-WAMR-1.3.3/wamr-sdk/Kconfig
```kconfig
mainmenu "WebAssembly Micro Runtime Configuration"

choice
    prompt "select a build target"

    config TARGET_X86_64
        bool "X86_64"

    config TARGET_X86_32
        bool "X86_32"

endchoice

choice
    prompt "select a target platform"

    config PLATFORM_LINUX
        bool "Linux"

endchoice

menu "select execution mode"
    comment "At least one execution mode must be selected"
    config EXEC_AOT
        bool "AOT"
        depends on PLATFORM_LINUX

    config EXEC_JIT
        bool "JIT"
        depends on PLATFORM_LINUX
        select BUILD_LLVM

    config BUILD_LLVM
        bool "build llvm (this may take a long time)"
        depends on EXEC_JIT
        help
            llvm library is required by JIT mode.

    config EXEC_INTERP
        bool "INTERPRETER"
        default y
endmenu

choice
    prompt "libc support"

    config LIBC_BUILTIN
        bool "builtin libc"
        help
            use builtin libc, this is a minimal subset of libc.

    config LIBC_WASI
        bool "WebAssembly System Interface [WASI]"
        depends on PLATFORM_LINUX
        help
            enable WebAssembly System Interface

endchoice

choice
    prompt "application framework"
    config APP_FRAMEWORK_DISABLE
        bool "Disable app framework"
        help
            Disable wamr app framework

    config APP_FRAMEWORK_DEFAULT
        bool "Default components"
        help
            Default components

    config APP_FRAMEWORK_ALL
        bool "All components"

    config APP_FRAMEWORK_CUSTOM
        bool "customized module config"

    menu "modules:"
        depends on APP_FRAMEWORK_CUSTOM

        source ".wamr_modules"

    endmenu
endchoice
```

## lib/wasm-micro-runtime-WAMR-2.4.1/build-scripts/esp-idf/wamr/Kconfig
```kconfig
menu "WASM Micro Runtime"
    choice WAMR_BUILD_TYPE
        prompt "Build type"
        default WAMR_BUILD_RELEASE

        config WAMR_BUILD_RELEASE
            bool "Release"

        config WAMR_BUILD_DEBUG
            bool "Debug"
    endchoice

    config WAMR_ENABLE_AOT
        bool "AOT"
        default y

    menuconfig WAMR_ENABLE_INTERP
        bool "Interpreter"
        default y

    if WAMR_ENABLE_INTERP

       choice WAMR_INTERP_MODE
            prompt "Interpreter mode"
            default WAMR_INTERP_FAST

            config WAMR_INTERP_CLASSIC
                bool "Classic"

            config WAMR_INTERP_FAST
                bool "Fast"
        endchoice

        choice WAMR_INTERP_LOADER_MODE
            prompt "Loader mode"
            default WAMR_INTERP_LOADER_NORMAL

            config WAMR_INTERP_LOADER_NORMAL
                bool "Normal"

            config WAMR_INTERP_LOADER_MINI
                bool "Mini"
        endchoice
    endif

    config WAMR_ENABLE_LIB_PTHREAD
        bool "Lib pthread"
        default y

    config WAMR_ENABLE_LIBC_BUILTIN
        bool "Libc builtin"
        default y

    config WAMR_ENABLE_LIBC_WASI
        bool "Libc WASI"
        default y

    config WAMR_ENABLE_MEMORY_PROFILING
        bool "Memory profiling"
        default n

    config WAMR_ENABLE_MULTI_MODULE
        bool "Multi module"
        default n

    config WAMR_ENABLE_PERF_PROFILING
        bool "Performance profiling"
        default n

    config WAMR_ENABLE_REF_TYPES
        bool "Reference types"
        default n

    config WAMR_ENABLE_SHARED_MEMORY
        bool "Shared memory"
        default n
endmenu
```

## lib/wasm-micro-runtime-WAMR-2.4.1/product-mini/platforms/esp-idf/sdkconfig.defaults
```kconfig
CONFIG_FREERTOS_USE_TRACE_FACILITY=y
# CONFIG_ESP_SYSTEM_MEMPROT_FEATURE is not set
```
